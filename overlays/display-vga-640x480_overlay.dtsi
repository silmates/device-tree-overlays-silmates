// SPDX-License-Identifier: GPL-2.0-or-later OR MIT
/*
 * Copyright 2022 Silmates
 */

// VGA Signal 640x480@60Hz Industry standard timing

&panel_dpi {
	compatible = "panel-dpi";
	status = "okay";

	/* for 0.3mm pixels */
	width-mm = <192>;
	height-mm = <144>;

	panel-timing {
		clock-frequency = <25175000>;
		hactive = <640>;
		vactive = <480>;
		hsync-len = <96>;
		hfront-porch = <16>;
		hback-porch = <48>;
		vsync-len = <2>;
		vfront-porch = <10>;
		vback-porch = <33>;
		hsync-active = <0>;
		vsync-active = <0>;
		pixelclk-active = <0>;
	 };
};
