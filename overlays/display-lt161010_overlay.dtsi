// SPDX-License-Identifier: GPL-2.0-or-later OR MIT
/*
 * Copyright 2020-2022 Silmates
 */

// LT161010 panel with a resolution of 800x480 pixel.

&panel_dpi {
	compatible = "panel-dpi";
	status = "okay";

	width-mm = <154>;
	height-mm = <86>;

	panel-timing {
		clock-frequency = <33230769>;
		hactive = <800>;
		vactive = <480>;
		hsync-len = <128>;
		hfront-porch = <40>;
		hback-porch = <88>;
		vsync-len = <1>;
		vfront-porch = <10>;
		vback-porch = <33>;
		pixelclk-active = <1>;
	};
};
