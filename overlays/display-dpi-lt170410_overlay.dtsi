// SPDX-License-Identifier: GPL-2.0-or-later OR MIT
/*
 * Copyright 2020-2022 Silmates
 */

// LT170410 panel with a resolution of 1280x800 pixel.

&panel_dpi {
	compatible = "panel-dpi";
	status = "okay";

	width-mm = <217>;
	height-mm = <136>;

	panel-timing {
		clock-frequency = <68930000>;

		hactive = <1280>;
		hback-porch = <64>;
		hfront-porch = <64>;
		hsync-len = <40>;
		vactive = <800>;
		vback-porch = <5>;
		vfront-porch = <5>;
		vsync-len = <6>;

		de-active = <1>;
		hsync-active = <0>;
		vsync-active = <0>;
		pixelclk-active = <0>;
	};
};
