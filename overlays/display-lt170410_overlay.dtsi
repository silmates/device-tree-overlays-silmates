// SPDX-License-Identifier: GPL-2.0-or-later OR MIT
/*
 * Copyright 2022 Silmates
 */

// LT170410 panel with a resolution of 1280x800 pixel.

&panel_lvds {
	status = "okay";

	data-mapping = "vesa-24";
	width-mm = <217>;
	height-mm = <136>;

	panel-timing {
		clock-frequency = <68930000>;
		hactive = <1280>;
		vactive = <800>;
		hback-porch = <64>;
		hfront-porch = <64>;
		vback-porch = <5>;
		vfront-porch = <5>;
		hsync-len = <40>;
		vsync-len = <6>;

		hsync-active = <0>;
		vsync-active = <0>;
		pixelclk-active = <0>;
	};
};
