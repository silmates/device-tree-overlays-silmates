// SPDX-License-Identifier: GPL-2.0-or-later OR MIT
/*
 * Copyright 2020-2022 Silmates
 */

// FullHD VGA monitor in mode 1920x1080p60. Standard: SMPTE 274M

&panel_dpi {
	compatible = "panel-dpi";
	status = "okay";

	/* for 0.15mm pixels */
	width-mm = <288>;
	height-mm = <162>;

	panel-timing {
		clock-frequency = <148500000>;
		hactive = <1920>;
		hback-porch = <148>;
		hfront-porch = <88>;
		hsync-len = <44>;
		vactive = <1080>;
		vback-porch = <36>;
		vfront-porch = <4>;
		vsync-len = <5>;
		pixelclk-active = <0>;
	};
};
